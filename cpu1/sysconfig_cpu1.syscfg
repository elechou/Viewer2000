/**
 * These arguments were used when this file was generated. They will be automatically applied on subsequent loads
 * via the GUI or CLI. Run CLI with '--help' for additional information on how to override these arguments.
 * @cliArgs --board "/boards/LAUNCHXL_F28P65X" --device "F28P65x" --part "F28P65x_169NMR" --package "169NMR" --context "CPU1" --product "C2000WARE@26.01.00.00"
 * @v2CliArgs --board "/boards/LAUNCHXL_F28P65X" --device "TMS320F28P650DK" --package "169NMR" --variant "TMS320F28P650DK9" --context "CPU1" --product "C2000WARE@26.01.00.00"
 * @versions {"tool":"1.27.1+4634"}
 */

/**
 * Import the modules used in this configuration.
 */
const led  = scripting.addModule("/driverlib/board_components/led", {}, false);
const led1 = led.addInstance();
const led2 = led.addInstance();

/**
 * Write custom configuration values to the imported modules.
 */
led1.$hardware              = system.deviceData.board.components.LED4;
led1.$name                  = "LED_CPU1";
led1.gpio.writeInitialValue = true;
led1.gpio.initialValue      = 1;

led2.$name                  = "LED_CPU2";
led2.$hardware              = system.deviceData.board.components.LED5;
led2.gpio.writeInitialValue = true;
led2.gpio.initialValue      = 1;
led2.gpio.controllerCore    = "GPIO_CORE_CPU2";

/**
 * Pinmux solution for unlocked pins/peripherals. This ensures that minor changes to the automatic solver in a future
 * version of the tool will not impact the pinmux you originally saw.  These lines can be completely deleted in order to
 * re-solve from scratch.
 */
led1.gpio.gpioPin.$suggestSolution = "boosterpack1.13";
led2.gpio.gpioPin.$suggestSolution = "boosterpack2.53";
