/**
 *
 * @cliArgs --board "/boards/LAUNCHXL_F28P65X" --device "F28P65x" --part "F28P65x_169NMR" --package "169NMR" --context "CPU2" --product "C2000WARE@26.01.00.00"
 * @versions {"tool":"1.28.0+4696"}
 */

/**
 * Import the modules used in this configuration.
 */
const device_support = scripting.addModule("/driverlib/device_support.js");
const sci            = scripting.addModule("/driverlib/sci.js", {}, false);
const sci1           = sci.addInstance();

/**
 * Write custom configuration values to the imported modules.
 */
sci1.$hardware    = system.deviceData.board.components.XDS_UART.subComponents.XDS_SCI_INST1;
sci1.$name        = "SCIA_BASE";
sci1.rxQual.$name = "myGPIOQUAL0";
sci1.txQual.$name = "myGPIOQUAL1";

/**
 * Pinmux solution for unlocked pins/peripherals. This ensures that minor changes to the automatic solver in a future
 * version of the tool will not impact the pinmux you originally saw.  These lines can be completely deleted in order to
 * re-solve from scratch.
 */
sci1.sci.$suggestSolution           = "SCIA";
sci1.sci.sci_rxPin.$suggestSolution = "boosterpack1.3";
sci1.sci.sci_txPin.$suggestSolution = "boosterpack1.4";
